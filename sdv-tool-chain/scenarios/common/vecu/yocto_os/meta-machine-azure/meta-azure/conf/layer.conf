## sdv-tool-chain/scenarios/common/vecu/yocto_os/meta-machine-azure/meta-azure/conf/layer.conf
```bitbake
BBPATH .= ":${LAYERDIR}"
BBFILES += "${LAYERDIR}/recipes-*/recipes-*/*/*.bb \
	    	${LAYERDIR}/recipes-*/recipes-*/*/*.bbappend"

BBFILE_COLLECTIONS += "meta-azure"
BBFILE_PATTERN_meta-azure = "^${LAYERDIR}/"
BBFILE_PRIORITY_meta-azure = "3"

# LAYERDEPENDS_meta-azure = "core openembedded-layer meta-arm"
LAYERSERIES_COMPAT_meta-azure = "kirkstone"
```

## sdv-tool-chain/scenarios/common/vecu/yocto_os/meta-machine-azure/meta-azure/conf/machine/azure-vm-arm64.conf
```bitbake
#@TYPE: Machine
#@NAME: Azure machine
#@DESCRIPTION: Machine configuration for Azure

# ----------------------
# machine configuration for Azure
# ----------------------

require conf/machine/include/arm/armv8-2a/tune-neoversen1.inc

KERNEL_IMAGETYPE = "Image"

IMAGE_FSTYPES += "wic wic.gz wic.vhd"
WKS_FILE ?= "azure-disk.wks.in"

# ----------------------
# grub-efi
# ----------------------
EFI_PROVIDER ?= "grub-efi"
MACHINE_FEATURES += "efi"

# ----------------------
# kernel configuration
# ----------------------
PREFERRED_PROVIDER_virtual/kernel ?= "linux-yocto"
KBUILD_DEFCONFIG = "defconfig"
KCONFIG_MODE = "--alldefconfig"
MACHINE_EXTRA_RRECOMMENDS += "kernel-modules linux-firmware"

# ----------------------
# cloud-init is required for provisioning.
# ----------------------
MACHINE_ESSENTIAL_EXTRA_RDEPENDS += "cloud-init-systemd"
```
